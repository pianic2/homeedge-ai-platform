## tools/hardware-validation/ihap-45-environmental-sensors/firmware/main/Kconfig.projbuild
```kconfig
menu "IHAP-45 validation harness"

config IHAP45_DHT11_GPIO
    int "DHT11 data GPIO"
    range 0 21
    default 3

config IHAP45_DHT22_GPIO
    int "DHT22 data GPIO"
    range 0 21
    default 4

config IHAP45_I2C_SDA_GPIO
    int "BME280 I2C SDA GPIO"
    range 0 21
    default 5

config IHAP45_I2C_SCL_GPIO
    int "BME280 I2C SCL GPIO"
    range 0 21
    default 6

config IHAP45_SAMPLE_INTERVAL_MS
    int "Batch interval in milliseconds"
    range 2000 60000
    default 5000

config IHAP45_I2C_FREQUENCY_HZ
    int "I2C clock frequency"
    range 10000 400000
    default 100000

config IHAP45_I2C_INTERNAL_PULLUPS
    bool "Enable ESP32-C3 internal I2C pull-ups"
    default n
    help
        Keep disabled for the initial breakout qualification. External/module
        pull-ups should be verified. Enable only as an explicit diagnostic step.

config IHAP45_DHT_INTERNAL_PULLUPS
    bool "Enable ESP32-C3 internal DHT pull-ups"
    default n
    help
        The photographed DHT breakouts contain passive components. Keep this
        disabled unless the module pull-up is proven absent.

endmenu
```

## tools/hardware-validation/ihap-45-environmental-sensors/firmware/sdkconfig.defaults
```kconfig
CONFIG_IDF_TARGET="esp32c3"
CONFIG_ESP_MAIN_TASK_STACK_SIZE=8192
CONFIG_LOG_DEFAULT_LEVEL_WARN=y
CONFIG_FREERTOS_HZ=1000
```

## tools/hardware-validation/ihap-46-presence-sensor/firmware/main/Kconfig.projbuild
```kconfig
menu "IHAP-46 presence validation harness"

config IHAP46_LD2410_RX_GPIO
    int "ESP32-C3 GPIO connected to LD2410C TX"
    range -1 21
    default 5
    help
        Historical prototype input used GPIO5. Set -1 to disable UART capture.

config IHAP46_LD2410_TX_GPIO
    int "ESP32-C3 GPIO connected to LD2410C RX"
    range -1 21
    default -1
    help
        Keep disabled for RX-only evidence unless command/configuration testing is explicitly required.

config IHAP46_LD2410_OUT_GPIO
    int "ESP32-C3 GPIO connected to LD2410C OUT"
    range -1 21
    default -1
    help
        Enable only after the exact module pinout and logic level are verified.

config IHAP46_PIR_OUT_GPIO
    int "ESP32-C3 GPIO connected to PIR OUT"
    range -1 21
    default -1
    help
        Set to a safe GPIO when an identified PIR specimen is included in the test.

config IHAP46_SAMPLE_PERIOD_MS
    int "Sample output period in milliseconds"
    range 50 5000
    default 100

config IHAP46_UART_TIMEOUT_MS
    int "Age after which LD2410C UART presence is stale"
    range 100 30000
    default 1500

endmenu
```
